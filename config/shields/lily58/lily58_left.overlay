/ {
    chosen {
        zmk,kscan = &kscan0;
    };
};

&kscan0 {
    col-gpios = <&gpio0 29 GPIO_ACTIVE_LOW>,
                <&gpio0 2 GPIO_ACTIVE_LOW>,
                <&gpio0 3 GPIO_ACTIVE_LOW>,
                <&gpio0 4 GPIO_ACTIVE_LOW>,
                <&gpio0 5 GPIO_ACTIVE_LOW>,
                <&gpio0 6 GPIO_ACTIVE_LOW>;
    row-gpios = <&gpio0 7 GPIO_ACTIVE_LOW>,
                <&gpio0 8 GPIO_ACTIVE_LOW>,
                <&gpio1 9 GPIO_ACTIVE_LOW>,
                <&gpio1 10 GPIO_ACTIVE_LOW>,
                <&gpio1 11 GPIO_ACTIVE_LOW>;
};
